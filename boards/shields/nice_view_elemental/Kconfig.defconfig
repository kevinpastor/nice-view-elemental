## boards/shields/nice_view_elemental/Kconfig.defconfig
```kconfig
if SHIELD_NICE_VIEW_ELEMENTAL
    config LV_Z_VDB_SIZE
        default 100

    config LV_DPI_DEF
        default 161

    config LV_Z_BITS_PER_PIXEL
        default 1

    choice LV_COLOR_DEPTH
        default LV_COLOR_DEPTH_1
    endchoice

    choice ZMK_DISPLAY_WORK_QUEUE
        default ZMK_DISPLAY_WORK_QUEUE_DEDICATED
    endchoice

    choice ZMK_DISPLAY_STATUS_SCREEN
        default ZMK_DISPLAY_STATUS_SCREEN_CUSTOM
    endchoice

    config LV_Z_MEM_POOL_SIZE
        default 4096 if ZMK_DISPLAY_STATUS_SCREEN_CUSTOM

    config ZMK_DISPLAY_STATUS_SCREEN_CUSTOM
        imply NICE_VIEW_WIDGET_STATUS

    config NICE_VIEW_WIDGET_STATUS
        bool "Custom nice!view status widget"
        select LV_FONT_MONTSERRAT_16
        select LV_USE_IMAGE
        select LV_USE_CANVAS
        select LV_USE_ANIMIMG

    config NICE_VIEW_ELEMENTAL_ANIMATION
        bool "Enables the background animation."
        default y

    config NICE_VIEW_ELEMENTAL_ANIMATION_FRAME_MS
        int "Frame delay for the animation, in milliseconds."
        default 150

    config NICE_VIEW_ELEMENTAL_CAPITALIZATION
        bool "Enables full capitalization for the layer name."
        default n

    config NICE_VIEW_ELEMENTAL_OUTLINE
        bool "Displays an outline around the shadow of the layer name."
        default n

    config NICE_VIEW_ELEMENTAL_SHADOW
        bool "Displays a shadow around the layer name."
        default n
endif
```
